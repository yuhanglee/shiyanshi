#include "oled.h"
#include "uart.h"
#include "stdio.h"
#include "wc_string.h"
#include "mylib.h"
#include "gt20.h"


//OLED的显存
//存放格式如下.
//[0]0 1 2 3 ... 127	
//[1]0 1 2 3 ... 127	
//[2]0 1 2 3 ... 127	
//[3]0 1 2 3 ... 127	
//[4]0 1 2 3 ... 127	
//[5]0 1 2 3 ... 127	
//[6]0 1 2 3 ... 127	
//[7]0 1 2 3 ... 127 			   
uint8_t OLED_GRAM[128][8] = {0};

/*************Pin Define***************/
sbit SCL=P7^7;
sbit SDA=P7^6;

/****************************************************/
void Delay_50ms(uint16_t Del_50ms);
void Delay_1ms(uint16_t Del_1ms);
void Delay_us(uint16_t us);
void fill_picture(uint8_t fill_Data);
void Picture_1();
void IIC_Start();
void IIC_Stop();
void Write_IIC_Command(uint8_t IIC_Command);
void Write_IIC_Data(uint8_t IIC_Data);
void Write_IIC_Byte(uint8_t IIC_Byte);



/***********************Delay****************************************/
static void Delay_50ms(uint16_t Del_50ms) {
	uint16_t m;

	for(;Del_50ms > 0;Del_50ms--) {
		for(m=6245;m>0;m--) {
        
        }
    }
}

static void Delay_1ms(uint16_t Del_1ms) {
	uint8_t j;
    
	while (Del_1ms--) {	
		for (j  =0;j < 123;j++) {
        
        }
	}
}
static void Delay_us(uint16_t us) {
    uint8_t i;
    (void)us;
	i = 2;
	while (--i);
}
/***********************Initial code*********************/
void OLED_Init(void) {
	Write_IIC_Command(OLED_CMD_SLEEP);   //display off
	Write_IIC_Command(OLED_CMD_MEMORY_MODE);	//Set Memory Addressing Mode	
	Write_IIC_Command(OLED_CMD_MEMORY_MODE_P_ADDR);	//00,Horizontal Addressing Mode;01,Vertical Addressing Mode;10,Page Addressing Mode (RESET);11,Invalid
	Write_IIC_Command(OLED_CMD_SET_PAGE_START_ADDR(OLED_CMD_SCROLL_PAGE_0));	//Set Page Start Address for Page Addressing Mode,0-7
	Write_IIC_Command(OLED_CMD_COM_OUT_SCAN_DIR_NOR);	//Set COM Output Scan Direction
	Write_IIC_Command(OLED_CMD_SET_LOW_ADDR(OLED_CMD_SCROLL_PAGE_0));//---set low column address
	Write_IIC_Command(OLED_CMD_SET_HIGH_ADDR(OLED_CMD_SCROLL_PAGE_0));//---set high column address
	Write_IIC_Command(OLED_CMD_SET_DISPLAY_START_LINE(0));//--set start line address
	Write_IIC_Command(OLED_CMD_CONTRAST);//--set contrast control register
	Write_IIC_Command(OLED_CMD_CONTRAST_VALUE(0x7f));
	Write_IIC_Command(OLED_CMD_SET_SEG_NOR);//--set segment re-map 0 to 127
	Write_IIC_Command(OLED_CMD_DSP_NOR);//--set normal display
	Write_IIC_Command(OLED_CMD_MUX_RATIO);//--set multiplex ratio(1 to 64)
	Write_IIC_Command(OLED_CMD_MUX_RATIO_VALUE(0x3F));//
	Write_IIC_Command(OLED_CMD_DSP_ON_RAM);//0xa4,Output follows RAM content;0xa5,Output ignores RAM content
	Write_IIC_Command(OLED_CMD_SET_DSP_OFFSET);//-set display offset
	Write_IIC_Command(OLED_CMD_SET_DSP_OFFSET_VALUE(0x00));//-not offset
	Write_IIC_Command(OLED_CMD_SET_DIV_OSC_FREQ);//--set display clock divide ratio/oscillator frequency
	Write_IIC_Command(OLED_CMD_SET_DIV_OSC_FREQ_VALUE(OLED_CMD_SET_DIV_VALUE(0) | OLED_CMD_SET_OSC_FREQ_VALUE(0x0f)));//--set divide ratio
	Write_IIC_Command(OLED_CMD_SET_PRE_CHARGE_PERIOD);//--set pre-charge period
	Write_IIC_Command(OLED_CMD_SET_PRE_CHARGE_PERIOD_VALUE(OLED_CMD_SET_PRE_CHARGE_PERIOD_1_VALUE(2) | OLED_CMD_SET_PRE_CHARGE_PERIOD_2_VALUE(2))); //
	Write_IIC_Command(OLED_CMD_SET_COM_PINS);//--set com pins hardware configuration
	Write_IIC_Command(OLED_CMD_SET_COM_PINS_VALUE(OLED_CMD_SET_COM_PINS_ALTER | OLED_CMD_SET_COM_PINS_RL_NOR));
	Write_IIC_Command(OLED_CMD_SET_VCOMH_DESELECT_LEVEL);//--set vcomh
	Write_IIC_Command(OLED_CMD_SET_VCOMH_DESELECT_LEVEL_0_77_VCC);//0x20,0.77xVcc
	Write_IIC_Command(OLED_CMD_SET_CHARGE_PUMP);//--set DC-DC enable
	Write_IIC_Command(OLED_CMD_SET_CHARGE_PUMP_ON);//
	Write_IIC_Command(OLED_CMD_SLEEP_OFF);//--turn on oled panel 
}
/*******************ascii**********************/
static const uint8_t ascii[][ASCII_SIZE_Y*ASCII_SIZE_X/8] = {
    {0x00, 0x00, 0x00, 0x00, 0x00, 0x00, 0x00, 0x00, 0x00, 0x00, 0x00, 0x00, 0x00, 0x00, 0x00, 0x00, }, //   0x20
    {0x00, 0x00, 0x00, 0xFE, 0xFE, 0x00, 0x00, 0x00, 0x00, 0x00, 0x00, 0x67, 0x67, 0x00, 0x00, 0x00, }, // ! 0x21
    {0x00, 0x3E, 0x0E, 0x00, 0x3E, 0x0E, 0x00, 0x00, 0x00, 0x00, 0x00, 0x00, 0x00, 0x00, 0x00, 0x00, }, // " 0x22
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    {0x01, 0x01, 0x01, 0x01, 0x01, 0x01, 0x00, 0x00, 0x00, 0x00, 0x00, 0x00, 0x00, 0x00, 0x00, 0x00, }, // ~ 0x7E
};

static const uint8_t logo[4][256] = {

{0x00,0x00,0x00,0x00,0x00,0x00,0x00,0x00,0x00,0x00,0x00,0x00,0x00,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0x00,0x00},
{0x00,0xC0,0xC0,0xE0,0xF0,0xF0,0xF8,0xF8,0xFC,0xFC,0xFE,0xFE,0xFF,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0x80,0x00},
{0x00,0xF8,0xFF,0xFF,0xFF,0xFF,0xFF,0x7F,0xEF,0xDF,0xFF,0xBE,0xFE,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0x00,0x00},
{0x00,0x00,0x00,0x00,0x00,0x00,0x00,0x00,0x00,0x00,0x00,0x01,0x01,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0x00,0x00},
};
/**********************************************
//IIC Start
**********************************************/
static void IIC_Start(void) {
   SCL = high;
   Delay_us(1);		
   SDA = high;
   Delay_us(1);
   SDA = low;
   Delay_us(1);
   SCL = low;
   Delay_us(1);
}

/**********************************************
//IIC Stop
**********************************************/
static void IIC_Stop(void) {
   SCL = low;
   Delay_us(1);
   SDA = low;
   Delay_us(1);
   SCL = high;
   Delay_us(1);
   SDA = high;
   Delay_us(1);
}
/**********************************************
// IIC Write byte
**********************************************/
static void Write_IIC_Byte(uint8_t IIC_Byte) {
	uint8_t i;
	for(i = 0;i < 8;i++) {
		if(IIC_Byte & 0x80) {		//1?0?
            SDA=high;
		} else {
            SDA=low;
        }
        
		Delay_us(1);
		SCL=high;
		Delay_us(1);
		SCL=low;
		Delay_us(1);
		IIC_Byte<<=1;			//loop
	}
	SDA=1;
	Delay_us(1);
	SCL=1;
	Delay_us(1);
	SCL=0;
	Delay_us(1);
}
/**********************************************
// IIC Write Command
**********************************************/
static void Write_IIC_Command(uint8_t IIC_Command) {
   IIC_Start();
   Write_IIC_Byte(OLED_WRITE);            //Slave address,SA0=0
   Write_IIC_Byte(0x00);			//write command
   Write_IIC_Byte(IIC_Command); 
   IIC_Stop();
}
/**********************************************
// IIC Write Data
**********************************************/
static void Write_IIC_Data(uint8_t IIC_Data) {
   IIC_Start();
   Write_IIC_Byte(OLED_WRITE);			
   Write_IIC_Byte(0x40);			//write data
   Write_IIC_Byte(IIC_Data);
   IIC_Stop();
}

void OLED_Scroll(uint8_t Direction, uint8_t StartPage, uint8_t EndPage, uint8_t Franes) {
    wc_assert(IS_DIRECTION(Direction));
    wc_assert(IS_PAGE(StartPage));
    wc_assert(IS_PAGE(EndPage));
    wc_assert(IS_FRANES(Franes));
    
    Write_IIC_Command(OLED_CMD_SCROLL_OFF);
    Write_IIC_Command(Direction);
    Write_IIC_Command(0x00);
    Write_IIC_Command(StartPage);
    Write_IIC_Command(Franes);
    Write_IIC_Command(EndPage);
    Write_IIC_Command(0x00);
    Write_IIC_Command(0xff);
    Write_IIC_Command(OLED_CMD_SCROLL_ON);
} 

//更新显存到LCD		 
void OLED_Refresh_Gram(void) {
    static uint8_t i = 0,n = 0;		    
    while (i < OLED_Y_MAX*ASCII_SIZE_Y/8) {
		Write_IIC_Command(0xb0+i);    //设置页地址（0~7）
		Write_IIC_Command(0x00);      //设置显示位置—列低地址
		Write_IIC_Command(0x10);      //设置显示位置—列高地址   

		for (n = 0;n < OLED_X_MAX * ASCII_SIZE_X;n++) {
            Write_IIC_Data(OLED_GRAM[n][i]);
        }
        i++;
	}
    i=0;
}


void OLED_DisplayIcon(uint8_t x, uint8_t y, uint8_t w, uint8_t h, uint8_t * ch, uint16_t len) {
    uint8_t i;
    uint8_t n = x << 3; // x*8
    
    wc_assert(x < OLED_X_MAX);
    wc_assert(y < OLED_Y_MAX);
    wc_assert((x + w / 8) <= OLED_X_MAX);
    wc_assert((y + h / 16) <= OLED_Y_MAX);
    
    for (i = 0;i < w;++i) {
        OLED_GRAM[n + i][y << 1]     = ch[i];
        OLED_GRAM[n + i][(y << 1) + 1] = ch[i + (len / 2)];
    }
}

void OLED_DisplayLogo(void) {
    OLED_DisplayIcon(0, 0, 128, 16, logo[0], sizeof(logo[0]));
    OLED_DisplayIcon(0, 1, 128, 16, logo[1], sizeof(logo[0]));
    OLED_DisplayIcon(0, 2, 128, 16, logo[2], sizeof(logo[0]));
    OLED_DisplayIcon(0, 3, 128, 16, logo[3], sizeof(logo[0]));
}

/*
 * x  0-15
 * y  0-3
 */
void OLED_DisplayChar(uint8_t x, uint8_t y, uint8_t ch) {
    uint8_t i;
    uint8_t n = x << 3; // x*8
    uint8_t index = ch - ' ';
    
    
    wc_assert(x < OLED_X_MAX);
    wc_assert(y < OLED_Y_MAX);
    
    for (i = 0;i < ASCII_SIZE_Y / 2;++i) {
        OLED_GRAM[n + i][y*2] = ascii[index][i];
        OLED_GRAM[n + i][y*2 + 1] = ascii[index][i + ASCII_SIZE_Y / 2];
    }
}
void OLED_DisplayStr(uint8_t x, uint8_t y, uint8_t * str) {
    uint8_t len = str_len(str);
    uint8_t i;
    
    wc_assert(x < OLED_X_MAX);
    wc_assert(y < OLED_Y_MAX);
    for (i = 0;(i < len) && ((x + i) < OLED_X_MAX);++i) {
        OLED_DisplayChar(x+i, y, str[i]);
    }
    
}

void OLED_DispalyHanzi(uint8_t x, uint8_t y, uint8_t msb, uint8_t lsb) {
	uint8_t dat[32];
    
    GT20_ReadChar(GT20FontAddr(msb, lsb), 16*16/8, dat);
    OLED_DisplayIcon(x, y, 16, 16, dat, 16*16/8);
}

void OLED_DisplayHanziStr(u8 x, u8 y, char * disStr) {
	u8 i;
	u8 len = str_len(disStr);
	u8 msb, msl;
	
    wc_assert(len <= OLED_X_MAX);
	for (i = 0;i < len;i+=2) {
		msb = disStr[i];
		msl = disStr[i + 1];
		OLED_DispalyHanzi(x+i, y, msb, msl);
	}
}
void OLED_Clear(void) {
    uint8_t i = 0, j = 0;
    
    for (i = 0;i < OLED_X_MAX * ASCII_SIZE_X;++i) {
        for (j = 0;j < OLED_Y_MAX * ASCII_SIZE_Y / 8;++j) {
            OLED_GRAM[i][j] = 0x00;
        }
    }
}
